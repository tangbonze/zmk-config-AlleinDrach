/*
 * Copyright (c) 2020 Pete Johanson
 *
 * SPDX-License-Identifier: MIT
 */

 #include "allein.dtsi"

 &default_transform {
     col-offset = <5>;
 };
 
 &five_column_transform {
     col-offset = <5>;
 };
 
 &kscan0 {
     col-gpios
         =<&gpio1 11 GPIO_ACTIVE_HIGH>
         , <&gpio0 3 GPIO_ACTIVE_HIGH>
         , <&gpio0 28 GPIO_ACTIVE_HIGH>
         , <&gpio1 13 GPIO_ACTIVE_HIGH>
         , <&gpio0 2 GPIO_ACTIVE_HIGH>
         ;
 };
 